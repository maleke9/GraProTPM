ASAP2_VERSION 1 41
/begin PROJECT PC_PC "Generated by ETAS from Project PC_PC"
/begin HEADER "" VERSION "000" PROJECT_NO ASD /end HEADER
/begin MODULE PC_PC "Generated by ETAS ASCET7 from Project: PC_PC"
/begin IF_DATA E_TARGET
 /begin SOURCE "Task0" 3 /* period */ 10 QP_BLOB 1 /end SOURCE
 /begin TP_BLOB /* programm id */ 3439352997 /* target id */ 7 0 2 0 /end TP_BLOB
/end IF_DATA
/begin MOD_PAR "" VERSION "000" ADDR_EPK 0x0 EPK "" SUPPLIER "ETAS GmbH" CUSTOMER "xxx" CUSTOMER_NO "000" USER "xxx" PHONE_NO "000" ECU "PC" CPU_TYPE "PCx86" NO_OF_INTERFACES 1 /end MOD_PAR
/begin MOD_COMMON "Common definitions" BYTE_ORDER MSB_LAST ALIGNMENT_BYTE 1 ALIGNMENT_WORD 2 ALIGNMENT_LONG 4 ALIGNMENT_FLOAT32_IEEE 4 ALIGNMENT_FLOAT64_IEEE 8 /end MOD_COMMON
/begin CHARACTERISTIC components.lib.IntegratorTest.integrate_inputVal "" VALUE 0x435088 STANDARD_VALUE_R32 0.0 esdl_ident -3.4028234663852886E+38 3.4028234663852886E+38 /end CHARACTERISTIC
/begin CHARACTERISTIC components.lib.IntegratorTest.integrate_dtVal "" VALUE 0x435084 STANDARD_VALUE_R32 0.0 esdl_ident -3.4028234663852886E+38 3.4028234663852886E+38 /end CHARACTERISTIC
/begin CHARACTERISTIC components.lib.IntegratorTest.tester.kI "" VALUE 0x43508C STANDARD_VALUE_R32 0.0 esdl_ident -3.4028234663852886E+38 3.4028234663852886E+38 /end CHARACTERISTIC
/begin CHARACTERISTIC components.Component.reset "" VALUE 0x452020 STANDARD_VALUE_U8 0.0 esdl_ident 0 1 BIT_MASK 0x1 /end CHARACTERISTIC
/begin CHARACTERISTIC components.Component.vflA "" VALUE 0x435064 STANDARD_VALUE_S32 0.0 esdl_ident -2147483648 2147483647 /end CHARACTERISTIC
/begin CHARACTERISTIC components.Component.vflC "" VALUE 0x435068 STANDARD_VALUE_S32 0.0 esdl_ident -2147483648 2147483647 /end CHARACTERISTIC
/begin CHARACTERISTIC components.Component.vflM "" VALUE 0x43506C STANDARD_VALUE_S32 0.0 esdl_ident -2147483648 2147483647 /end CHARACTERISTIC
/begin CHARACTERISTIC components.Component.gain "" VALUE 0x435060 STANDARD_VALUE_R32 0.0 esdl_ident -3.4028234663852886E+38 3.4028234663852886E+38 /end CHARACTERISTIC
/begin CHARACTERISTIC components.Component.Integrator_instance.kI "" VALUE 0x435070 STANDARD_VALUE_R32 0.0 esdl_ident -3.4028234663852886E+38 3.4028234663852886E+38 /end CHARACTERISTIC
/begin CHARACTERISTIC components.Component.Integrator_instance1.kI "" VALUE 0x435074 STANDARD_VALUE_R32 0.0 esdl_ident -3.4028234663852886E+38 3.4028234663852886E+38 /end CHARACTERISTIC
/begin CHARACTERISTIC components.Component.Integrator_instance2.kI "" VALUE 0x435078 STANDARD_VALUE_R32 0.0 esdl_ident -3.4028234663852886E+38 3.4028234663852886E+38 /end CHARACTERISTIC
/begin CHARACTERISTIC components.Component.Integrator_instance3.kI "" VALUE 0x43507C STANDARD_VALUE_R32 0.0 esdl_ident -3.4028234663852886E+38 3.4028234663852886E+38 /end CHARACTERISTIC
/begin CHARACTERISTIC components.lib.diffCheck.border "" VALUE 0x435080 STANDARD_VALUE_R32 0.0 esdl_ident -3.4028234663852886E+38 3.4028234663852886E+38 /end CHARACTERISTIC
/begin MEASUREMENT components.lib.IntegratorTest.outVal_return "" FLOAT32_IEEE esdl_ident 1 100.0 -3.4028234663852886E+38 3.4028234663852886E+38 ECU_ADDRESS 0x452048 /end MEASUREMENT
/begin MEASUREMENT components.lib.IntegratorTest.tester.memory "" FLOAT32_IEEE esdl_ident 1 100.0 -3.4028234663852886E+38 3.4028234663852886E+38 ECU_ADDRESS 0x45204C /end MEASUREMENT
/begin MEASUREMENT components.Component.Integrator_instance.memory "" FLOAT32_IEEE esdl_ident 1 100.0 -3.4028234663852886E+38 3.4028234663852886E+38 ECU_ADDRESS 0x435000 /end MEASUREMENT
/begin MEASUREMENT components.Component.Integrator_instance1.memory "" FLOAT32_IEEE esdl_ident 1 100.0 -3.4028234663852886E+38 3.4028234663852886E+38 ECU_ADDRESS 0x435004 /end MEASUREMENT
/begin MEASUREMENT components.Component.Integrator_instance2.memory "" FLOAT32_IEEE esdl_ident 1 100.0 -3.4028234663852886E+38 3.4028234663852886E+38 ECU_ADDRESS 0x435008 /end MEASUREMENT
/begin MEASUREMENT components.Component.Integrator_instance3.memory "" FLOAT32_IEEE esdl_ident 1 100.0 -3.4028234663852886E+38 3.4028234663852886E+38 ECU_ADDRESS 0x43500C /end MEASUREMENT
/begin MEASUREMENT components.Component.TirePressureProject_instance.mem "" UWORD esdl_ident 1 100.0 1 10000 ECU_ADDRESS 0x435040 /end MEASUREMENT
/begin MEASUREMENT components.Component.NoiseGenerator_instance.mem "" UWORD esdl_ident 1 100.0 1 10000 ECU_ADDRESS 0x435010 /end MEASUREMENT
/begin MEASUREMENT components.Component.NoiseGenerator_instance_2.mem "" UWORD esdl_ident 1 100.0 1 10000 ECU_ADDRESS 0x435012 /end MEASUREMENT
/begin MEASUREMENT components.Component.NoiseGenerator_instance_3.mem "" UWORD esdl_ident 1 100.0 1 10000 ECU_ADDRESS 0x435014 /end MEASUREMENT
/begin MEASUREMENT components.Component.NoiseGenerator_instance_4.mem "" UWORD esdl_ident 1 100.0 1 10000 ECU_ADDRESS 0x435016 /end MEASUREMENT
/begin MEASUREMENT components.Component.SoundOutStateMaschine_instance.sm "" UBYTE esdl_components_SoundOutStateMaschineStatemachineStates 1 100.0 0 3 ECU_ADDRESS 0x435029 /end MEASUREMENT
/begin MEASUREMENT components.Component.SoundOutStateMaschine_instance.deltaTime "" FLOAT32_IEEE esdl_ident 1 100.0 -3.4028234663852886E+38 3.4028234663852886E+38 ECU_ADDRESS 0x435020 /end MEASUREMENT
/begin MEASUREMENT components.Component.SoundOutStateMaschine_instance.time "" FLOAT32_IEEE esdl_ident 1 100.0 -3.4028234663852886E+38 3.4028234663852886E+38 ECU_ADDRESS 0x435024 /end MEASUREMENT
/begin MEASUREMENT components.Component.SoundOutStateMaschine_instance.countShort "" SLONG esdl_ident 1 100.0 -2147483648 2147483647 ECU_ADDRESS 0x43501C /end MEASUREMENT
/begin MEASUREMENT components.Component.SoundOutStateMaschine_instance.countLong "" SLONG esdl_ident 1 100.0 -2147483648 2147483647 ECU_ADDRESS 0x435018 /end MEASUREMENT
/begin MEASUREMENT components.Component.SoundOutStateMaschine_instance.lampOn "" UBYTE esdl_ident 1 100.0 0 1 ECU_ADDRESS 0x435028 BIT_MASK 0x1 /end MEASUREMENT
/begin MEASUREMENT components.Component.SoundOutStateMaschine_instance_2.sm "" UBYTE esdl_components_SoundOutStateMaschineStatemachineStates 1 100.0 0 3 ECU_ADDRESS 0x43503D /end MEASUREMENT
/begin MEASUREMENT components.Component.SoundOutStateMaschine_instance_2.deltaTime "" FLOAT32_IEEE esdl_ident 1 100.0 -3.4028234663852886E+38 3.4028234663852886E+38 ECU_ADDRESS 0x435034 /end MEASUREMENT
/begin MEASUREMENT components.Component.SoundOutStateMaschine_instance_2.time "" FLOAT32_IEEE esdl_ident 1 100.0 -3.4028234663852886E+38 3.4028234663852886E+38 ECU_ADDRESS 0x435038 /end MEASUREMENT
/begin MEASUREMENT components.Component.SoundOutStateMaschine_instance_2.countShort "" SLONG esdl_ident 1 100.0 -2147483648 2147483647 ECU_ADDRESS 0x435030 /end MEASUREMENT
/begin MEASUREMENT components.Component.SoundOutStateMaschine_instance_2.countLong "" SLONG esdl_ident 1 100.0 -2147483648 2147483647 ECU_ADDRESS 0x43502C /end MEASUREMENT
/begin MEASUREMENT components.Component.SoundOutStateMaschine_instance_2.lampOn "" UBYTE esdl_ident 1 100.0 0 1 ECU_ADDRESS 0x43503C BIT_MASK 0x1 /end MEASUREMENT
/begin MEASUREMENT components.veloCar.vfl "" FLOAT32_IEEE esdl_ident 1 100.0 -3.4028234663852886E+38 3.4028234663852886E+38 ECU_ADDRESS 0x452064 /end MEASUREMENT
/begin MEASUREMENT components.veloCar.vfr "" FLOAT32_IEEE esdl_ident 1 100.0 -3.4028234663852886E+38 3.4028234663852886E+38 ECU_ADDRESS 0x452060 /end MEASUREMENT
/begin MEASUREMENT components.veloCar.vrl "" FLOAT32_IEEE esdl_ident 1 100.0 -3.4028234663852886E+38 3.4028234663852886E+38 ECU_ADDRESS 0x45205C /end MEASUREMENT
/begin MEASUREMENT components.veloCar.vrr "" FLOAT32_IEEE esdl_ident 1 100.0 -3.4028234663852886E+38 3.4028234663852886E+38 ECU_ADDRESS 0x452058 /end MEASUREMENT
/begin MEASUREMENT components.distanceCar.sfl "" FLOAT32_IEEE esdl_ident 1 100.0 -3.4028234663852886E+38 3.4028234663852886E+38 ECU_ADDRESS 0x452040 /end MEASUREMENT
/begin MEASUREMENT components.distanceCar.sfr "" FLOAT32_IEEE esdl_ident 1 100.0 -3.4028234663852886E+38 3.4028234663852886E+38 ECU_ADDRESS 0x45203C /end MEASUREMENT
/begin MEASUREMENT components.distanceCar.srl "" FLOAT32_IEEE esdl_ident 1 100.0 -3.4028234663852886E+38 3.4028234663852886E+38 ECU_ADDRESS 0x452038 /end MEASUREMENT
/begin MEASUREMENT components.distanceCar.srr "" FLOAT32_IEEE esdl_ident 1 100.0 -3.4028234663852886E+38 3.4028234663852886E+38 ECU_ADDRESS 0x452034 /end MEASUREMENT
/begin MEASUREMENT components.distanceCar.avgDistanceCar "" FLOAT32_IEEE esdl_ident 1 100.0 -3.4028234663852886E+38 3.4028234663852886E+38 ECU_ADDRESS 0x452044 /end MEASUREMENT
/begin MEASUREMENT components.diffWheel.diffFl "" FLOAT32_IEEE esdl_ident 1 100.0 -3.4028234663852886E+38 3.4028234663852886E+38 ECU_ADDRESS 0x452030 /end MEASUREMENT
/begin MEASUREMENT components.diffWheel.diffFr "" FLOAT32_IEEE esdl_ident 1 100.0 -3.4028234663852886E+38 3.4028234663852886E+38 ECU_ADDRESS 0x45202C /end MEASUREMENT
/begin MEASUREMENT components.diffWheel.diffRl "" FLOAT32_IEEE esdl_ident 1 100.0 -3.4028234663852886E+38 3.4028234663852886E+38 ECU_ADDRESS 0x452028 /end MEASUREMENT
/begin MEASUREMENT components.diffWheel.diffRr "" FLOAT32_IEEE esdl_ident 1 100.0 -3.4028234663852886E+38 3.4028234663852886E+38 ECU_ADDRESS 0x452024 /end MEASUREMENT
/begin MEASUREMENT components.pressureError.errFl "" UBYTE esdl_ident 1 100.0 0 1 ECU_ADDRESS 0x452053 BIT_MASK 0x1 /end MEASUREMENT
/begin MEASUREMENT components.pressureError.errFr "" UBYTE esdl_ident 1 100.0 0 1 ECU_ADDRESS 0x452052 BIT_MASK 0x1 /end MEASUREMENT
/begin MEASUREMENT components.pressureError.errRl "" UBYTE esdl_ident 1 100.0 0 1 ECU_ADDRESS 0x452051 BIT_MASK 0x1 /end MEASUREMENT
/begin MEASUREMENT components.pressureError.errRr "" UBYTE esdl_ident 1 100.0 0 1 ECU_ADDRESS 0x452050 BIT_MASK 0x1 /end MEASUREMENT
/begin MEASUREMENT components.pressureError.err "" UBYTE esdl_ident 1 100.0 0 1 ECU_ADDRESS 0x452054 BIT_MASK 0x1 /end MEASUREMENT
/begin COMPU_METHOD esdl_ident "" RAT_FUNC /* format */ "%12.4" /* unit */ "" /* coeffs */ COEFFS 0 1 0 0 0 1 /end COMPU_METHOD
/begin COMPU_METHOD esdl_components_SoundOutStateMaschineStatemachineStates "" TAB_VERB /* format */ "%12.4" /* unit */ "" /* compu_tab_ref */ COMPU_TAB_REF esdl_components_SoundOutStateMaschineStatemachineStates_vtab /end COMPU_METHOD
/begin COMPU_VTAB esdl_components_SoundOutStateMaschineStatemachineStates_vtab "" TAB_VERB /* number value pairs */ 4 3 "stateLampShort" 2 "stateLampOff" 1 "stateLampLong" 0 "waitstate" /* default value */ DEFAULT_VALUE "Error" /end COMPU_VTAB
/begin FUNCTION PC_PC ""
 /begin SUB_FUNCTION components.lib.IntegratorTest components.Component components.lib.diffCheck /end SUB_FUNCTION
/end FUNCTION
/begin FUNCTION components.lib.IntegratorTest ""
 /begin DEF_CHARACTERISTIC components.lib.IntegratorTest.integrate_inputVal components.lib.IntegratorTest.integrate_dtVal /end DEF_CHARACTERISTIC
 /begin LOC_MEASUREMENT components.lib.IntegratorTest.outVal_return /end LOC_MEASUREMENT
 /begin SUB_FUNCTION components.lib.IntegratorTest.tester /end SUB_FUNCTION
/end FUNCTION
/begin FUNCTION components.lib.IntegratorTest.tester "" /begin DEF_CHARACTERISTIC components.lib.IntegratorTest.tester.kI /end DEF_CHARACTERISTIC /begin LOC_MEASUREMENT components.lib.IntegratorTest.tester.memory /end LOC_MEASUREMENT /end FUNCTION
/begin FUNCTION components.Component ""
 /begin DEF_CHARACTERISTIC components.Component.reset components.Component.vflA components.Component.vflC components.Component.vflM components.Component.gain /end DEF_CHARACTERISTIC
 /begin IN_MEASUREMENT components.diffWheel.diffFl components.diffWheel.diffFr components.diffWheel.diffRl components.diffWheel.diffRr components.distanceCar.avgDistanceCar components.distanceCar.sfl components.distanceCar.sfr components.distanceCar.srl components.distanceCar.srr components.veloCar.vfl components.veloCar.vfr components.veloCar.vrl components.veloCar.vrr /end IN_MEASUREMENT
 /begin OUT_MEASUREMENT components.diffWheel.diffFl components.diffWheel.diffFr components.diffWheel.diffRl components.diffWheel.diffRr components.distanceCar.avgDistanceCar components.distanceCar.sfl components.distanceCar.sfr components.distanceCar.srl components.distanceCar.srr components.pressureError.err components.pressureError.errFl components.pressureError.errFr components.pressureError.errRl components.pressureError.errRr /end OUT_MEASUREMENT
 /begin SUB_FUNCTION components.Component.average_instance components.Component.Integrator_instance components.Component.Integrator_instance1 components.Component.Integrator_instance2 components.Component.Integrator_instance3 components.Component.percentCompare_instance components.Component.percentCompare_instance1 components.Component.percentCompare_instance2 components.Component.percentCompare_instance3 components.Component.TirePressureProject_instance components.Component.NoiseGenerator_instance components.Component.NoiseGenerator_instance_2 components.Component.NoiseGenerator_instance_3 components.Component.NoiseGenerator_instance_4 components.Component.SoundOutStateMaschine_instance components.Component.SoundOutStateMaschine_instance_2 /end SUB_FUNCTION
/end FUNCTION
/begin FUNCTION components.Component.average_instance "" /end FUNCTION
/begin FUNCTION components.Component.Integrator_instance "" /begin DEF_CHARACTERISTIC components.Component.Integrator_instance.kI /end DEF_CHARACTERISTIC /begin LOC_MEASUREMENT components.Component.Integrator_instance.memory /end LOC_MEASUREMENT /end FUNCTION
/begin FUNCTION components.Component.Integrator_instance1 "" /begin DEF_CHARACTERISTIC components.Component.Integrator_instance1.kI /end DEF_CHARACTERISTIC /begin LOC_MEASUREMENT components.Component.Integrator_instance1.memory /end LOC_MEASUREMENT /end FUNCTION
/begin FUNCTION components.Component.Integrator_instance2 "" /begin DEF_CHARACTERISTIC components.Component.Integrator_instance2.kI /end DEF_CHARACTERISTIC /begin LOC_MEASUREMENT components.Component.Integrator_instance2.memory /end LOC_MEASUREMENT /end FUNCTION
/begin FUNCTION components.Component.Integrator_instance3 "" /begin DEF_CHARACTERISTIC components.Component.Integrator_instance3.kI /end DEF_CHARACTERISTIC /begin LOC_MEASUREMENT components.Component.Integrator_instance3.memory /end LOC_MEASUREMENT /end FUNCTION
/begin FUNCTION components.Component.percentCompare_instance "" /end FUNCTION
/begin FUNCTION components.Component.percentCompare_instance1 "" /end FUNCTION
/begin FUNCTION components.Component.percentCompare_instance2 "" /end FUNCTION
/begin FUNCTION components.Component.percentCompare_instance3 "" /end FUNCTION
/begin FUNCTION components.Component.TirePressureProject_instance "" /begin LOC_MEASUREMENT components.Component.TirePressureProject_instance.mem /end LOC_MEASUREMENT /end FUNCTION
/begin FUNCTION components.Component.NoiseGenerator_instance "" /begin LOC_MEASUREMENT components.Component.NoiseGenerator_instance.mem /end LOC_MEASUREMENT /end FUNCTION
/begin FUNCTION components.Component.NoiseGenerator_instance_2 "" /begin LOC_MEASUREMENT components.Component.NoiseGenerator_instance_2.mem /end LOC_MEASUREMENT /end FUNCTION
/begin FUNCTION components.Component.NoiseGenerator_instance_3 "" /begin LOC_MEASUREMENT components.Component.NoiseGenerator_instance_3.mem /end LOC_MEASUREMENT /end FUNCTION
/begin FUNCTION components.Component.NoiseGenerator_instance_4 "" /begin LOC_MEASUREMENT components.Component.NoiseGenerator_instance_4.mem /end LOC_MEASUREMENT /end FUNCTION
/begin FUNCTION components.Component.SoundOutStateMaschine_instance ""
 /begin LOC_MEASUREMENT components.Component.SoundOutStateMaschine_instance.countLong components.Component.SoundOutStateMaschine_instance.countShort components.Component.SoundOutStateMaschine_instance.deltaTime components.Component.SoundOutStateMaschine_instance.lampOn components.Component.SoundOutStateMaschine_instance.sm components.Component.SoundOutStateMaschine_instance.time /end LOC_MEASUREMENT
/end FUNCTION
/begin FUNCTION components.Component.SoundOutStateMaschine_instance_2 ""
 /begin LOC_MEASUREMENT components.Component.SoundOutStateMaschine_instance_2.countLong components.Component.SoundOutStateMaschine_instance_2.countShort components.Component.SoundOutStateMaschine_instance_2.deltaTime components.Component.SoundOutStateMaschine_instance_2.lampOn components.Component.SoundOutStateMaschine_instance_2.sm components.Component.SoundOutStateMaschine_instance_2.time /end LOC_MEASUREMENT
/end FUNCTION
/begin FUNCTION components.lib.diffCheck "" /begin DEF_CHARACTERISTIC components.lib.diffCheck.border /end DEF_CHARACTERISTIC /end FUNCTION
/begin RECORD_LAYOUT STANDARD_VALUE_R32 FNC_VALUES 1 FLOAT32_IEEE COLUMN_DIR DIRECT /end RECORD_LAYOUT
/begin RECORD_LAYOUT STANDARD_VALUE_U8 FNC_VALUES 1 UBYTE COLUMN_DIR DIRECT /end RECORD_LAYOUT
/begin RECORD_LAYOUT STANDARD_VALUE_S32 FNC_VALUES 1 SLONG COLUMN_DIR DIRECT /end RECORD_LAYOUT
/begin GROUP PC_PC "" ROOT
 /begin SUB_GROUP components.lib.IntegratorTest components.Component components.veloCar components.distanceCar components.diffWheel components.pressureError components.lib.diffCheck /end SUB_GROUP
/end GROUP
/begin GROUP components.lib.IntegratorTest ""
 /begin REF_CHARACTERISTIC components.lib.IntegratorTest.integrate_inputVal components.lib.IntegratorTest.integrate_dtVal /end REF_CHARACTERISTIC
 /begin REF_MEASUREMENT components.lib.IntegratorTest.outVal_return /end REF_MEASUREMENT
 /begin SUB_GROUP components.lib.IntegratorTest.tester /end SUB_GROUP
/end GROUP
/begin GROUP components.lib.IntegratorTest.tester "" /begin REF_CHARACTERISTIC components.lib.IntegratorTest.tester.kI /end REF_CHARACTERISTIC /begin REF_MEASUREMENT components.lib.IntegratorTest.tester.memory /end REF_MEASUREMENT /end GROUP
/begin GROUP components.Component ""
 /begin REF_CHARACTERISTIC components.Component.reset components.Component.vflA components.Component.vflC components.Component.vflM components.Component.gain /end REF_CHARACTERISTIC
 /begin SUB_GROUP components.Component.average_instance components.Component.Integrator_instance components.Component.Integrator_instance1 components.Component.Integrator_instance2 components.Component.Integrator_instance3 components.Component.percentCompare_instance components.Component.percentCompare_instance1 components.Component.percentCompare_instance2 components.Component.percentCompare_instance3 components.Component.TirePressureProject_instance components.Component.NoiseGenerator_instance components.Component.NoiseGenerator_instance_2 components.Component.NoiseGenerator_instance_3 components.Component.NoiseGenerator_instance_4 components.Component.SoundOutStateMaschine_instance components.Component.SoundOutStateMaschine_instance_2 /end SUB_GROUP
/end GROUP
/begin GROUP components.Component.average_instance "" /end GROUP
/begin GROUP components.Component.Integrator_instance "" /begin REF_CHARACTERISTIC components.Component.Integrator_instance.kI /end REF_CHARACTERISTIC /begin REF_MEASUREMENT components.Component.Integrator_instance.memory /end REF_MEASUREMENT /end GROUP
/begin GROUP components.Component.Integrator_instance1 "" /begin REF_CHARACTERISTIC components.Component.Integrator_instance1.kI /end REF_CHARACTERISTIC /begin REF_MEASUREMENT components.Component.Integrator_instance1.memory /end REF_MEASUREMENT /end GROUP
/begin GROUP components.Component.Integrator_instance2 "" /begin REF_CHARACTERISTIC components.Component.Integrator_instance2.kI /end REF_CHARACTERISTIC /begin REF_MEASUREMENT components.Component.Integrator_instance2.memory /end REF_MEASUREMENT /end GROUP
/begin GROUP components.Component.Integrator_instance3 "" /begin REF_CHARACTERISTIC components.Component.Integrator_instance3.kI /end REF_CHARACTERISTIC /begin REF_MEASUREMENT components.Component.Integrator_instance3.memory /end REF_MEASUREMENT /end GROUP
/begin GROUP components.Component.percentCompare_instance "" /end GROUP
/begin GROUP components.Component.percentCompare_instance1 "" /end GROUP
/begin GROUP components.Component.percentCompare_instance2 "" /end GROUP
/begin GROUP components.Component.percentCompare_instance3 "" /end GROUP
/begin GROUP components.Component.TirePressureProject_instance "" /begin REF_MEASUREMENT components.Component.TirePressureProject_instance.mem /end REF_MEASUREMENT /end GROUP
/begin GROUP components.Component.NoiseGenerator_instance "" /begin REF_MEASUREMENT components.Component.NoiseGenerator_instance.mem /end REF_MEASUREMENT /end GROUP
/begin GROUP components.Component.NoiseGenerator_instance_2 "" /begin REF_MEASUREMENT components.Component.NoiseGenerator_instance_2.mem /end REF_MEASUREMENT /end GROUP
/begin GROUP components.Component.NoiseGenerator_instance_3 "" /begin REF_MEASUREMENT components.Component.NoiseGenerator_instance_3.mem /end REF_MEASUREMENT /end GROUP
/begin GROUP components.Component.NoiseGenerator_instance_4 "" /begin REF_MEASUREMENT components.Component.NoiseGenerator_instance_4.mem /end REF_MEASUREMENT /end GROUP
/begin GROUP components.Component.SoundOutStateMaschine_instance ""
 /begin REF_MEASUREMENT components.Component.SoundOutStateMaschine_instance.countLong components.Component.SoundOutStateMaschine_instance.countShort components.Component.SoundOutStateMaschine_instance.deltaTime components.Component.SoundOutStateMaschine_instance.lampOn components.Component.SoundOutStateMaschine_instance.sm components.Component.SoundOutStateMaschine_instance.time /end REF_MEASUREMENT
/end GROUP
/begin GROUP components.Component.SoundOutStateMaschine_instance_2 ""
 /begin REF_MEASUREMENT components.Component.SoundOutStateMaschine_instance_2.countLong components.Component.SoundOutStateMaschine_instance_2.countShort components.Component.SoundOutStateMaschine_instance_2.deltaTime components.Component.SoundOutStateMaschine_instance_2.lampOn components.Component.SoundOutStateMaschine_instance_2.sm components.Component.SoundOutStateMaschine_instance_2.time /end REF_MEASUREMENT
/end GROUP
/begin GROUP components.veloCar ""
 /begin REF_MEASUREMENT components.veloCar.vfl components.veloCar.vfr components.veloCar.vrl components.veloCar.vrr /end REF_MEASUREMENT
/end GROUP
/begin GROUP components.distanceCar ""
 /begin REF_MEASUREMENT components.distanceCar.avgDistanceCar components.distanceCar.sfl components.distanceCar.sfr components.distanceCar.srl components.distanceCar.srr /end REF_MEASUREMENT
/end GROUP
/begin GROUP components.diffWheel ""
 /begin REF_MEASUREMENT components.diffWheel.diffFl components.diffWheel.diffFr components.diffWheel.diffRl components.diffWheel.diffRr /end REF_MEASUREMENT
/end GROUP
/begin GROUP components.pressureError ""
 /begin REF_MEASUREMENT components.pressureError.err components.pressureError.errFl components.pressureError.errFr components.pressureError.errRl components.pressureError.errRr /end REF_MEASUREMENT
/end GROUP
/begin GROUP components.lib.diffCheck "" /begin REF_CHARACTERISTIC components.lib.diffCheck.border /end REF_CHARACTERISTIC /end GROUP
/end MODULE
/end PROJECT
