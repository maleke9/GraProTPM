ASAP2_VERSION 1 41
/begin PROJECT PC_PC_1_ "Generated by ETAS from Project PC_PC_1_"
/begin HEADER "" VERSION "000" PROJECT_NO ASD /end HEADER
/begin MODULE PC_PC_1_ "Generated by ETAS ASCET7 from Project: PC_PC_1_"
/begin IF_DATA E_TARGET
 /begin SOURCE "Task0" 3 /* period */ 10 QP_BLOB 1 /end SOURCE
 /begin TP_BLOB /* programm id */ 3313519039 /* target id */ 7 0 2 0 /end TP_BLOB
/end IF_DATA
/begin MOD_PAR "" VERSION "000" ADDR_EPK 0x0 EPK "" SUPPLIER "ETAS GmbH" CUSTOMER "xxx" CUSTOMER_NO "000" USER "xxx" PHONE_NO "000" ECU "PC" CPU_TYPE "PCx86" NO_OF_INTERFACES 1 /end MOD_PAR
/begin MOD_COMMON "Common definitions" BYTE_ORDER MSB_LAST ALIGNMENT_BYTE 1 ALIGNMENT_WORD 2 ALIGNMENT_LONG 4 ALIGNMENT_FLOAT32_IEEE 4 ALIGNMENT_FLOAT64_IEEE 8 /end MOD_COMMON
/begin CHARACTERISTIC components.lib.IntegratorTest.integrate_inputVal "" VALUE 0x434018 STANDARD_VALUE_R32 0.0 esdl_ident -3.4028234663852886E+38 3.4028234663852886E+38 /end CHARACTERISTIC
/begin CHARACTERISTIC components.lib.IntegratorTest.integrate_dtVal "" VALUE 0x434014 STANDARD_VALUE_R32 0.0 esdl_ident -3.4028234663852886E+38 3.4028234663852886E+38 /end CHARACTERISTIC
/begin CHARACTERISTIC components.lib.IntegratorTest.tester.kI "" VALUE 0x43401C STANDARD_VALUE_R32 0.0 esdl_ident -3.4028234663852886E+38 3.4028234663852886E+38 /end CHARACTERISTIC
/begin CHARACTERISTIC components.lib.diffCheck.border "" VALUE 0x434010 STANDARD_VALUE_R32 0.0 esdl_ident -3.4028234663852886E+38 3.4028234663852886E+38 /end CHARACTERISTIC
/begin CHARACTERISTIC components.Component.Integrator_instance.kI "" VALUE 0x434000 STANDARD_VALUE_R32 0.0 esdl_ident -3.4028234663852886E+38 3.4028234663852886E+38 /end CHARACTERISTIC
/begin CHARACTERISTIC components.Component.Integrator_instance1.kI "" VALUE 0x434004 STANDARD_VALUE_R32 0.0 esdl_ident -3.4028234663852886E+38 3.4028234663852886E+38 /end CHARACTERISTIC
/begin CHARACTERISTIC components.Component.Integrator_instance2.kI "" VALUE 0x434008 STANDARD_VALUE_R32 0.0 esdl_ident -3.4028234663852886E+38 3.4028234663852886E+38 /end CHARACTERISTIC
/begin CHARACTERISTIC components.Component.Integrator_instance3.kI "" VALUE 0x43400C STANDARD_VALUE_R32 0.0 esdl_ident -3.4028234663852886E+38 3.4028234663852886E+38 /end CHARACTERISTIC
/begin MEASUREMENT components.lib.IntegratorTest.outVal_return "" FLOAT32_IEEE esdl_ident 1 100.0 -3.4028234663852886E+38 3.4028234663852886E+38 ECU_ADDRESS 0x451054 /end MEASUREMENT
/begin MEASUREMENT components.lib.IntegratorTest.tester.memory "" FLOAT32_IEEE esdl_ident 1 100.0 -3.4028234663852886E+38 3.4028234663852886E+38 ECU_ADDRESS 0x451058 /end MEASUREMENT
/begin MEASUREMENT components.Component.Integrator_instance.memory "" FLOAT32_IEEE esdl_ident 1 100.0 -3.4028234663852886E+38 3.4028234663852886E+38 ECU_ADDRESS 0x451020 /end MEASUREMENT
/begin MEASUREMENT components.Component.Integrator_instance1.memory "" FLOAT32_IEEE esdl_ident 1 100.0 -3.4028234663852886E+38 3.4028234663852886E+38 ECU_ADDRESS 0x451024 /end MEASUREMENT
/begin MEASUREMENT components.Component.Integrator_instance2.memory "" FLOAT32_IEEE esdl_ident 1 100.0 -3.4028234663852886E+38 3.4028234663852886E+38 ECU_ADDRESS 0x451028 /end MEASUREMENT
/begin MEASUREMENT components.Component.Integrator_instance3.memory "" FLOAT32_IEEE esdl_ident 1 100.0 -3.4028234663852886E+38 3.4028234663852886E+38 ECU_ADDRESS 0x45102C /end MEASUREMENT
/begin MEASUREMENT components.veloCar.vfl "" FLOAT32_IEEE esdl_ident 1 100.0 -3.4028234663852886E+38 3.4028234663852886E+38 ECU_ADDRESS 0x451084 /end MEASUREMENT
/begin MEASUREMENT components.veloCar.vfr "" FLOAT32_IEEE esdl_ident 1 100.0 -3.4028234663852886E+38 3.4028234663852886E+38 ECU_ADDRESS 0x451080 /end MEASUREMENT
/begin MEASUREMENT components.veloCar.vrl "" FLOAT32_IEEE esdl_ident 1 100.0 -3.4028234663852886E+38 3.4028234663852886E+38 ECU_ADDRESS 0x45107C /end MEASUREMENT
/begin MEASUREMENT components.veloCar.vrr "" FLOAT32_IEEE esdl_ident 1 100.0 -3.4028234663852886E+38 3.4028234663852886E+38 ECU_ADDRESS 0x451078 /end MEASUREMENT
/begin MEASUREMENT components.distanceCar.sfl "" FLOAT32_IEEE esdl_ident 1 100.0 -3.4028234663852886E+38 3.4028234663852886E+38 ECU_ADDRESS 0x45104C /end MEASUREMENT
/begin MEASUREMENT components.distanceCar.sfr "" FLOAT32_IEEE esdl_ident 1 100.0 -3.4028234663852886E+38 3.4028234663852886E+38 ECU_ADDRESS 0x451048 /end MEASUREMENT
/begin MEASUREMENT components.distanceCar.srl "" FLOAT32_IEEE esdl_ident 1 100.0 -3.4028234663852886E+38 3.4028234663852886E+38 ECU_ADDRESS 0x451044 /end MEASUREMENT
/begin MEASUREMENT components.distanceCar.srr "" FLOAT32_IEEE esdl_ident 1 100.0 -3.4028234663852886E+38 3.4028234663852886E+38 ECU_ADDRESS 0x451040 /end MEASUREMENT
/begin MEASUREMENT components.distanceCar.avgDistanceCar "" FLOAT32_IEEE esdl_ident 1 100.0 -3.4028234663852886E+38 3.4028234663852886E+38 ECU_ADDRESS 0x451050 /end MEASUREMENT
/begin MEASUREMENT components.diffWheel.diffFl "" FLOAT32_IEEE esdl_ident 1 100.0 -3.4028234663852886E+38 3.4028234663852886E+38 ECU_ADDRESS 0x45103C /end MEASUREMENT
/begin MEASUREMENT components.diffWheel.diffFr "" FLOAT32_IEEE esdl_ident 1 100.0 -3.4028234663852886E+38 3.4028234663852886E+38 ECU_ADDRESS 0x451038 /end MEASUREMENT
/begin MEASUREMENT components.diffWheel.diffRl "" FLOAT32_IEEE esdl_ident 1 100.0 -3.4028234663852886E+38 3.4028234663852886E+38 ECU_ADDRESS 0x451034 /end MEASUREMENT
/begin MEASUREMENT components.diffWheel.diffRr "" FLOAT32_IEEE esdl_ident 1 100.0 -3.4028234663852886E+38 3.4028234663852886E+38 ECU_ADDRESS 0x451030 /end MEASUREMENT
/begin MEASUREMENT components.pressureError.errFl "" UBYTE esdl_ident 1 100.0 0 1 ECU_ADDRESS 0x451073 BIT_MASK 0x1 /end MEASUREMENT
/begin MEASUREMENT components.pressureError.errFr "" UBYTE esdl_ident 1 100.0 0 1 ECU_ADDRESS 0x451072 BIT_MASK 0x1 /end MEASUREMENT
/begin MEASUREMENT components.pressureError.errRl "" UBYTE esdl_ident 1 100.0 0 1 ECU_ADDRESS 0x451071 BIT_MASK 0x1 /end MEASUREMENT
/begin MEASUREMENT components.pressureError.errRr "" UBYTE esdl_ident 1 100.0 0 1 ECU_ADDRESS 0x451070 BIT_MASK 0x1 /end MEASUREMENT
/begin MEASUREMENT components.pressureError.err "" UBYTE esdl_ident 1 100.0 0 1 ECU_ADDRESS 0x451074 BIT_MASK 0x1 /end MEASUREMENT
/begin MEASUREMENT components.lib.statemaschine.SoundOutStateMaschine_instance.sm "" UBYTE esdl_components_SoundOutStateMaschineStatemachineStates 1 100.0 0 4 ECU_ADDRESS 0x45106D /end MEASUREMENT
/begin MEASUREMENT components.lib.statemaschine.SoundOutStateMaschine_instance.deltaTime "" FLOAT32_IEEE esdl_ident 1 100.0 -3.4028234663852886E+38 3.4028234663852886E+38 ECU_ADDRESS 0x451064 /end MEASUREMENT
/begin MEASUREMENT components.lib.statemaschine.SoundOutStateMaschine_instance.time "" FLOAT32_IEEE esdl_ident 1 100.0 -3.4028234663852886E+38 3.4028234663852886E+38 ECU_ADDRESS 0x451068 /end MEASUREMENT
/begin MEASUREMENT components.lib.statemaschine.SoundOutStateMaschine_instance.countShort "" SLONG esdl_ident 1 100.0 -2147483648 2147483647 ECU_ADDRESS 0x451060 /end MEASUREMENT
/begin MEASUREMENT components.lib.statemaschine.SoundOutStateMaschine_instance.countLong "" SLONG esdl_ident 1 100.0 -2147483648 2147483647 ECU_ADDRESS 0x45105C /end MEASUREMENT
/begin MEASUREMENT components.lib.statemaschine.SoundOutStateMaschine_instance.lampOn "" UBYTE esdl_ident 1 100.0 0 1 ECU_ADDRESS 0x45106C BIT_MASK 0x1 /end MEASUREMENT
/begin COMPU_METHOD esdl_ident "" RAT_FUNC /* format */ "%12.4" /* unit */ "" /* coeffs */ COEFFS 0 1 0 0 0 1 /end COMPU_METHOD
/begin COMPU_METHOD esdl_components_SoundOutStateMaschineStatemachineStates "" TAB_VERB /* format */ "%12.4" /* unit */ "" /* compu_tab_ref */ COMPU_TAB_REF esdl_components_SoundOutStateMaschineStatemachineStates_vtab /end COMPU_METHOD
/begin COMPU_VTAB esdl_components_SoundOutStateMaschineStatemachineStates_vtab "" TAB_VERB /* number value pairs */ 5 4 "stateLampShort" 3 "stateLampOff" 2 "stateLampLong" 1 "off" 0 "waitstate" /* default value */ DEFAULT_VALUE "Error" /end COMPU_VTAB
/begin FUNCTION PC_PC_1_ ""
 /begin SUB_FUNCTION components.lib.IntegratorTest components.lib.diffCheck components.Component components.lib.statemaschine /end SUB_FUNCTION
/end FUNCTION
/begin FUNCTION components.lib.IntegratorTest ""
 /begin DEF_CHARACTERISTIC components.lib.IntegratorTest.integrate_inputVal components.lib.IntegratorTest.integrate_dtVal /end DEF_CHARACTERISTIC
 /begin LOC_MEASUREMENT components.lib.IntegratorTest.outVal_return /end LOC_MEASUREMENT
 /begin SUB_FUNCTION components.lib.IntegratorTest.tester /end SUB_FUNCTION
/end FUNCTION
/begin FUNCTION components.lib.IntegratorTest.tester "" /begin DEF_CHARACTERISTIC components.lib.IntegratorTest.tester.kI /end DEF_CHARACTERISTIC /begin LOC_MEASUREMENT components.lib.IntegratorTest.tester.memory /end LOC_MEASUREMENT /end FUNCTION
/begin FUNCTION components.lib.diffCheck "" /begin DEF_CHARACTERISTIC components.lib.diffCheck.border /end DEF_CHARACTERISTIC /end FUNCTION
/begin FUNCTION components.Component ""
 /begin IN_MEASUREMENT components.diffWheel.diffFl components.diffWheel.diffFr components.diffWheel.diffRl components.diffWheel.diffRr components.distanceCar.avgDistanceCar components.distanceCar.sfl components.distanceCar.sfr components.distanceCar.srl components.distanceCar.srr components.veloCar.vfl components.veloCar.vfr components.veloCar.vrl components.veloCar.vrr /end IN_MEASUREMENT
 /begin OUT_MEASUREMENT components.diffWheel.diffFl components.diffWheel.diffFr components.diffWheel.diffRl components.diffWheel.diffRr components.distanceCar.avgDistanceCar components.distanceCar.sfl components.distanceCar.sfr components.distanceCar.srl components.distanceCar.srr components.pressureError.err components.pressureError.errFl components.pressureError.errFr components.pressureError.errRl components.pressureError.errRr /end OUT_MEASUREMENT
 /begin SUB_FUNCTION components.Component.average_instance components.Component.Integrator_instance components.Component.Integrator_instance1 components.Component.Integrator_instance2 components.Component.Integrator_instance3 components.Component.percentCompare_instance components.Component.percentCompare_instance1 components.Component.percentCompare_instance2 components.Component.percentCompare_instance3 /end SUB_FUNCTION
/end FUNCTION
/begin FUNCTION components.Component.average_instance "" /end FUNCTION
/begin FUNCTION components.Component.Integrator_instance "" /begin DEF_CHARACTERISTIC components.Component.Integrator_instance.kI /end DEF_CHARACTERISTIC /begin LOC_MEASUREMENT components.Component.Integrator_instance.memory /end LOC_MEASUREMENT /end FUNCTION
/begin FUNCTION components.Component.Integrator_instance1 "" /begin DEF_CHARACTERISTIC components.Component.Integrator_instance1.kI /end DEF_CHARACTERISTIC /begin LOC_MEASUREMENT components.Component.Integrator_instance1.memory /end LOC_MEASUREMENT /end FUNCTION
/begin FUNCTION components.Component.Integrator_instance2 "" /begin DEF_CHARACTERISTIC components.Component.Integrator_instance2.kI /end DEF_CHARACTERISTIC /begin LOC_MEASUREMENT components.Component.Integrator_instance2.memory /end LOC_MEASUREMENT /end FUNCTION
/begin FUNCTION components.Component.Integrator_instance3 "" /begin DEF_CHARACTERISTIC components.Component.Integrator_instance3.kI /end DEF_CHARACTERISTIC /begin LOC_MEASUREMENT components.Component.Integrator_instance3.memory /end LOC_MEASUREMENT /end FUNCTION
/begin FUNCTION components.Component.percentCompare_instance "" /end FUNCTION
/begin FUNCTION components.Component.percentCompare_instance1 "" /end FUNCTION
/begin FUNCTION components.Component.percentCompare_instance2 "" /end FUNCTION
/begin FUNCTION components.Component.percentCompare_instance3 "" /end FUNCTION
/begin FUNCTION components.lib.statemaschine ""
 /begin SUB_FUNCTION components.lib.statemaschine.SoundOutStateMaschine_instance /end SUB_FUNCTION
/end FUNCTION
/begin FUNCTION components.lib.statemaschine.SoundOutStateMaschine_instance ""
 /begin LOC_MEASUREMENT components.lib.statemaschine.SoundOutStateMaschine_instance.countLong components.lib.statemaschine.SoundOutStateMaschine_instance.countShort components.lib.statemaschine.SoundOutStateMaschine_instance.deltaTime components.lib.statemaschine.SoundOutStateMaschine_instance.lampOn components.lib.statemaschine.SoundOutStateMaschine_instance.sm components.lib.statemaschine.SoundOutStateMaschine_instance.time /end LOC_MEASUREMENT
/end FUNCTION
/begin RECORD_LAYOUT STANDARD_VALUE_R32 /* value */ FNC_VALUES 1 FLOAT32_IEEE COLUMN_DIR DIRECT /end RECORD_LAYOUT
/begin GROUP PC_PC_1_ "" ROOT
 /begin SUB_GROUP components.lib.IntegratorTest components.lib.diffCheck components.Component components.veloCar components.distanceCar components.diffWheel components.pressureError components.lib.statemaschine /end SUB_GROUP
/end GROUP
/begin GROUP components.lib.IntegratorTest ""
 /begin REF_CHARACTERISTIC components.lib.IntegratorTest.integrate_inputVal components.lib.IntegratorTest.integrate_dtVal /end REF_CHARACTERISTIC
 /begin REF_MEASUREMENT components.lib.IntegratorTest.outVal_return /end REF_MEASUREMENT
 /begin SUB_GROUP components.lib.IntegratorTest.tester /end SUB_GROUP
/end GROUP
/begin GROUP components.lib.IntegratorTest.tester "" /begin REF_CHARACTERISTIC components.lib.IntegratorTest.tester.kI /end REF_CHARACTERISTIC /begin REF_MEASUREMENT components.lib.IntegratorTest.tester.memory /end REF_MEASUREMENT /end GROUP
/begin GROUP components.lib.diffCheck "" /begin REF_CHARACTERISTIC components.lib.diffCheck.border /end REF_CHARACTERISTIC /end GROUP
/begin GROUP components.Component ""
 /begin SUB_GROUP components.Component.average_instance components.Component.Integrator_instance components.Component.Integrator_instance1 components.Component.Integrator_instance2 components.Component.Integrator_instance3 components.Component.percentCompare_instance components.Component.percentCompare_instance1 components.Component.percentCompare_instance2 components.Component.percentCompare_instance3 /end SUB_GROUP
/end GROUP
/begin GROUP components.Component.average_instance "" /end GROUP
/begin GROUP components.Component.Integrator_instance "" /begin REF_CHARACTERISTIC components.Component.Integrator_instance.kI /end REF_CHARACTERISTIC /begin REF_MEASUREMENT components.Component.Integrator_instance.memory /end REF_MEASUREMENT /end GROUP
/begin GROUP components.Component.Integrator_instance1 "" /begin REF_CHARACTERISTIC components.Component.Integrator_instance1.kI /end REF_CHARACTERISTIC /begin REF_MEASUREMENT components.Component.Integrator_instance1.memory /end REF_MEASUREMENT /end GROUP
/begin GROUP components.Component.Integrator_instance2 "" /begin REF_CHARACTERISTIC components.Component.Integrator_instance2.kI /end REF_CHARACTERISTIC /begin REF_MEASUREMENT components.Component.Integrator_instance2.memory /end REF_MEASUREMENT /end GROUP
/begin GROUP components.Component.Integrator_instance3 "" /begin REF_CHARACTERISTIC components.Component.Integrator_instance3.kI /end REF_CHARACTERISTIC /begin REF_MEASUREMENT components.Component.Integrator_instance3.memory /end REF_MEASUREMENT /end GROUP
/begin GROUP components.Component.percentCompare_instance "" /end GROUP
/begin GROUP components.Component.percentCompare_instance1 "" /end GROUP
/begin GROUP components.Component.percentCompare_instance2 "" /end GROUP
/begin GROUP components.Component.percentCompare_instance3 "" /end GROUP
/begin GROUP components.veloCar ""
 /begin REF_MEASUREMENT components.veloCar.vfl components.veloCar.vfr components.veloCar.vrl components.veloCar.vrr /end REF_MEASUREMENT
/end GROUP
/begin GROUP components.distanceCar ""
 /begin REF_MEASUREMENT components.distanceCar.avgDistanceCar components.distanceCar.sfl components.distanceCar.sfr components.distanceCar.srl components.distanceCar.srr /end REF_MEASUREMENT
/end GROUP
/begin GROUP components.diffWheel ""
 /begin REF_MEASUREMENT components.diffWheel.diffFl components.diffWheel.diffFr components.diffWheel.diffRl components.diffWheel.diffRr /end REF_MEASUREMENT
/end GROUP
/begin GROUP components.pressureError ""
 /begin REF_MEASUREMENT components.pressureError.err components.pressureError.errFl components.pressureError.errFr components.pressureError.errRl components.pressureError.errRr /end REF_MEASUREMENT
/end GROUP
/begin GROUP components.lib.statemaschine ""
 /begin SUB_GROUP components.lib.statemaschine.SoundOutStateMaschine_instance /end SUB_GROUP
/end GROUP
/begin GROUP components.lib.statemaschine.SoundOutStateMaschine_instance ""
 /begin REF_MEASUREMENT components.lib.statemaschine.SoundOutStateMaschine_instance.countLong components.lib.statemaschine.SoundOutStateMaschine_instance.countShort components.lib.statemaschine.SoundOutStateMaschine_instance.deltaTime components.lib.statemaschine.SoundOutStateMaschine_instance.lampOn components.lib.statemaschine.SoundOutStateMaschine_instance.sm components.lib.statemaschine.SoundOutStateMaschine_instance.time /end REF_MEASUREMENT
/end GROUP
/end MODULE
/end PROJECT
